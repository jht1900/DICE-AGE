/* pioneer.c
Control that disc player.
4/15/87 JT.
*/

#include <Quickdraw.h>
#include <SerialDvr.h>

#include "pioneer.h"

VdOpen()
/*
Open pioneer interface. port=0 for portA (modem), =1 for portB.
*/
	{
	int vd;
	int vRefNum = 0;
	int serConfig = baud9600 + stop10 + noParity + data8;
	int er;
	SerShk	sh;
	
	sh.fXOn = 0;
	sh.fCTS = 1;
	sh.evts = 0;
	sh.fInX = 0;
	sh.fDTR = 0;
		
	vd = AoutRefNum;	
	er = RAMSDOpen(sPortA);
	if (er) OhShit("\p RAMSopen er");

	er = SerReset(vd, serConfig);
	if (er) OhShit("\p serreset of output");

	er = SerReset(vd + 1, serConfig);
	if (er) OhShit("\p serreset of input");
	
	er = SerHShake(vd, &sh);
	if (er) OhShit("\p serhshake out");
	
	er = SerHShake(vd+1, &sh);
	if (er) OhShit("\p serhshake in");
	
	return (vd);
	}
	
Vd(vd, what, arg)
	int vd;
	int	what;
	int	arg;
	{
	VdSendNum(vd, arg);
	VdSendByte(vd, what);
	VdSendEOL(vd);
	}
	
Vd1(vd, what)
	int	vd;
	int	what;
	{
	VdSendByte(vd, what);
	VdSendEOL(vd);
	}
	
static Byte digMap[10] = { 0x3F, 0x0F, 0x8F, 0x4F, 0x2F, 
							0xAF, 0x6F, 0x1F, 0x9F, 0x5F };
static VdSendNum(vd, arg)
	int 			vd;
	unsigned int	arg;
	{
	Byte buf[16];
	int i;

	stcu_d(buf, (long)arg, 16);
	/* sprintf(buf, "%u", arg); */
	
	for (i = 0; ; i++)
		{
		if (! buf[i]) return;
		VdSendByte(vd, digMap[buf[i] - '0']);
		}
	}
	
static Byte hexMap[16] = { '0', '1', '2', '3', '4', 
							'5', '6' , '7', '8', '9', 
							'A', 'B', 'C', 'D', 'E', 'F' };
	
static VdSendByte(vd, n)
	{
	VdSendRaw(vd, hexMap[(n>>4) & 0x0f]);
	VdSendRaw(vd, hexMap[n & 0x0f]);
	}
	
static VdSendEOL(vd)
	{
	VdSendRaw(vd, 0x0D);
	VdSendRaw(vd, 0x0A);
	}
	
VdSendRaw(vd, n)
	Byte	n;
	{
	long count = 1;
	int er;
	
#if 0	
 	printf("%c", n);
#endif

	er = FSWrite(vd, &count, &n);
	if (er) OhShit("VdSendRaw: er=%d\n", er);
	}

