/* pioneer.c
Control that disc player.
4/15/87 JT.
*/

#include <Quickdraw.h>
#include <SerialDvr.h>

#include "pioneer.h"

VdOpen(port)
/*
Open pioneer interface. port=0 for portA (modem), =1 for portB.
*/
	{
	int vd;
	int vRefNum = 0;
	int serConfig = baud9600 + stop10 + noParity + data8;
	int er;
		
	if (! port) vd = AoutRefNum;
	else vd = BoutRefNum;
	
	er = RAMSDOpen(port? sPortB: sPortA);
	if (er) OhShit("Er=%d on RAMSopen\n", er);

	er = SerReset(vd, serConfig);
	if (er) OhShit("er=%d on serreset of input\n", er);
	
	er = SerReset(vd + 1, serConfig);
	if (er) OhShit("er=%d on serreset of output\n", er);
	
	return (vd);
	}
	
Vd(vd, what, arg)
	int vd;
	int	what;
	int	arg;
	{
	switch (what)
		{
		case SetAudio:
			what += arg;
			break;
		case AutoStop:
		case DisplayFrame:
		case Search:
		case SearchRetry:
		case SlowSpeed:
		case FastSpeed:
		case SearchFwd:
		case SearchRev:
			VdSendNum(vd, arg);
			break;
		}
	VdSendByte(vd, what);
	VdSendEOL(vd);
	}
	
static Byte digMap[10] = { 0x3F, 0x0F, 0x8F, 0x4F, 0x2F, 
							0xAF, 0x6F, 0x1F, 0x9F, 0x5F };
static VdSendNum(vd, arg)
	int vd;
	int	arg;
	{
	Byte buf[16];
	int i;

	sprintf(buf, "%u", arg);
	
	for (i = 0; ; i++)
		{
		if (! buf[i]) return;
		VdSendByte(vd, digMap[buf[i] - '0']);
		}
	}
	
static Byte hexMap[16] = { '0', '1', '2', '3', '4', 
							'5', '6' , '7', '8', '9', 
							'A', 'B', 'C', 'D', 'E', 'F' };
	
static VdSendByte(vd, n)
	{
	VdSendRaw(vd, hexMap[(n>>4) & 0x0f]);
	VdSendRaw(vd, hexMap[n & 0x0f]);
	}
	
static VdSendEOL(vd)
	{
	VdSendRaw(vd, 0x0D);
	VdSendRaw(vd, 0x0A);
	}
	
static VdSendRaw(vd, n)
	Byte	n;
	{
	long count = 1;
	int er;
	
#if 0	
 	printf("%c", n);
#endif

	er = FSWrite(vd, &count, &n);
	if (er) OhShit("VdSendRaw: er=%d\n", er);
	}

