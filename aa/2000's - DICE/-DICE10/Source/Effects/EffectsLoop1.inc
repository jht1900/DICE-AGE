/* Define CODE_INNER_LOOP and include to generate code for motion effect.
*/
	const BitMap	*pSource; 
	const BitMap	*pDest;
	GrafPtr	myPort = GetMacPort();

	PixMapHandle		pmapSourceHd;
	PixMapHandle		pmapPreviousHd;
	PixMapHandle		pmapMonitorHd;

	int					hcount, vcount, width, height;
	Rect				box;
	
	UInt8*				sourcePtr; 
	UInt8*				previousPtr; 
	UInt8*				motionPtr; 
	
	int					rowBytes;
	
	UInt8*				sourceLinePtr;
	UInt8*				previousLinePtr;
	UInt8*				monitorLinePtr;
	
	int					inside;
	
	pmapSourceHd = GetGWorldPixMap(gwSourcePtr);
	pmapPreviousHd = GetGWorldPixMap(gwPreviousPtr);
	pmapMonitorHd = GetGWorldPixMap(gwMonitorPtr);
	
	sourcePtr = (UInt8*)GetPixBaseAddr( pmapSourceHd );
	previousPtr = (UInt8*)GetPixBaseAddr( pmapPreviousHd );
	motionPtr = (UInt8*)GetPixBaseAddr( pmapMonitorHd );
	
	rowBytes = (**pmapSourceHd).rowBytes & 0x3FFF;
			
	box = (**pmapSourceHd).bounds;
	width = box.right - box.left;
	height = box.bottom - box.top;

	//motionPtr += width*4;
	for (vcount = height; 
		vcount > 0; 
		vcount--, sourcePtr += rowBytes, previousPtr += rowBytes, motionPtr += rowBytes)
	{
		sourceLinePtr = sourcePtr+1;
		previousLinePtr = previousPtr+1;
		monitorLinePtr = motionPtr+1;
		
		inside = 0;
		
		for (hcount =  width; 
			hcount > 0; 
			hcount--, sourceLinePtr+=4, previousLinePtr+=4, monitorLinePtr+=4)
		{
			{
				CODE_INNER_LOOP
			}
			/* Copy over for next diff */
			previousLinePtr[0] = sourceLinePtr[0];
			previousLinePtr[1] = sourceLinePtr[1];
			previousLinePtr[2] = sourceLinePtr[2];
		}
	}
	pSource = GetPortBitMapForCopyBits( gwMonitorPtr );
	pDest = GetPortBitMapForCopyBits( myPort );
	CopyBits( pSource, pDest, &captureRect, &drawRect, inkMode, 0);

	gwLastOutput = gwMonitorPtr;
