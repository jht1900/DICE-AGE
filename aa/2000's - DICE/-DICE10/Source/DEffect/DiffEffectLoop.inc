/* Define CODE_INNER_LOOP and include to generate code for motion effect.
*/
	
	UInt8*				sourcePtr; 
	UInt8*				previousPtr; 
	UInt8*				outputPtr; 
	int					rowBytes, rowBytesPrev, rowBytesOut;
	Rect				box;

	int					hcount, vcount, width, height;
	UInt8*				sourceLinePtr;
	UInt8*				previousLinePtr;
	UInt8*				outputLinePtr;
		
	// All must have same bounds
	this->input->GetPixBaseInfo( &sourcePtr, &rowBytes, &box);
	this->previous->GetPixBaseInfo( &previousPtr, &rowBytesPrev, 0/*bounds*/);
	this->output->GetPixBaseInfo( &outputPtr, &rowBytesOut, 0/*bounds*/);

	width = box.right - box.left;
	height = box.bottom - box.top;

	//outputPtr += width*4;
	for (vcount = height; 
		vcount > 0; 
		vcount--, sourcePtr += rowBytes, previousPtr += rowBytesPrev, outputPtr += rowBytesOut)
	{
		sourceLinePtr = sourcePtr+1;
		previousLinePtr = previousPtr+1;
		outputLinePtr = outputPtr+1;
		
		#ifdef CODE_OUTTER_LOOP
		CODE_OUTTER_LOOP
		#endif
		
		for (hcount =  width; 
			hcount > 0; 
			hcount--, sourceLinePtr+=4, previousLinePtr+=4, outputLinePtr+=4)
		{
			{
				CODE_INNER_LOOP
			}
			/* Copy over for next diff */
			previousLinePtr[0] = sourceLinePtr[0];
			previousLinePtr[1] = sourceLinePtr[1];
			previousLinePtr[2] = sourceLinePtr[2];
		}
	}
