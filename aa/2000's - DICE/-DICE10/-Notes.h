
FSPathMakeRef
Converts a path into an FSRef structure.

OSStatus FSPathMakeRef (
   const UInt8 * path,
   FSRef * ref,
   Boolean * isDirectory
);




Link Error   : undefined: 'js_Disassemble1' (code)
Referenced from 'DisassWithSrc(JSContext*,JSObject*,unsigned int,long*,long*)' in dicejs.cp

Link Error   : undefined: 'js_Disassemble' (code)
Referenced from 'Disassemble(JSContext*,JSObject*,unsigned int,long*,long*)' in dicejs.cp



SetMovieTimeValue
Sets a movie's time value.

void ` (
   Movie        theMovie,
   TimeValue    newtime )
   
   
   
GetMovieBox
Returns a movie's boundary rectangle, which is a rectangle that encompasses all of the movie's enabled tracks.

void GetMovieBox (
   Movie    theMovie,
   Rect     *boxRect );
   

GetMovieTime

    theTrackCount = GetMovieTrackCount((**theDocHndl).theMovie);
    theModifierStruct.graphicsMode = transparent;
    theModifierStruct.opColor = gKeyColor;
    theModifierTrack = GetMovieIndTrack((**theDocHndl).theMovie,theTrackCount+1);
    // step thru until first video track found
    for (count=1;count <=theTrackCount;count++)
    {
      theTrack = GetMovieIndTrack((**theDocHndl).theMovie,count);
      theMedia = GetTrackMedia(theTrack);
      GetMediaHandlerDescription(theMedia,&theMediaType,nil,nil);
      if (theMediaType == VideoMediaType)
      {
      

GetMovieIndTrackType
Searches for all of a movie's tracks that share a given media type or media characteristic.

Track GetMovieIndTrackType (
   Movie     theMovie,
   long      index,
   OSType    trackType,
   long      flags );

Parameters
theMovie
The movie for this operation. Your application obtains this identifier from such functions as
 NewMovie, NewMovieFromFile, and NewMovieFromHandle.
index
The index value of the track for this operation. This is not that same as the track's index 
value in the movie. Rather, this parameter is an index into the set of tracks that meet your 
other selection criteria.
trackType
Contains either a media type or a media characteristic value. The toolbox applies this value
 to the search, and returns information about tracks that meet this criterion. You indicate 
 whether you have specified a media type or characteristic value by setting the flags 
 parameter appropriately.
flags
Contains flags (see below) that control the search operation. Note that you may not set both
 movieTrackMediaType and movieTrackCharacteristic to 1. See these constants:
	¥	movieTrackMediaType
	¥	movieTrackCharacteristic
	¥	movieTrackEnabledOnly


      
http://www.j4u2.com/backtalk/blog/wp-content/plugins/videoComments
/videoCommentsPop.php?
postid=31
&movie=http://www.j4u2.com/backtalk/blog/_GWTW/clips/02000_Panic_Atlanta.mov%20
&height=259
&width=320
&timecode=0
&title=02000_Panic_Atlanta%20-%20clip

Error   : function call '[DxMovieMaker].GetMaxCompressionSize(
{lval} PixMap **, 
{lval} Rect, 
int, 
@enum$10386FinalCarbonPrefix_pch__,
@enum$10373FinalCarbonPrefix_pch__, 
ComponentRecord *, 
long *)' does not match
 
'GetMaxCompressionSize(
PixMap **, 
const Rect *, 
short, 
unsigned long, 
unsigned long, 
ComponentRecord *, 
long *)'


DxMovieMaker.cp line 198            &maxCompressedSize);  




kAnimationCodecType ='rle '
kAVRJPEGCodecType ='avr '
kBaseCodecType               ='base'
kBMPCodecType                ='WRLE'
kCinepakCodecType            ='cvid'
kCloudCodecType              ='clou'
kCMYKCodecType               ='cmyk'
kComponentVideoCodecType     ='yuv2'
kComponentVideoSigned        ='yuvu'
kComponentVideoUnsigned      ='yuvs'
kDVCNTSCCodecType ='dvc '
kDVCPALCodecType             ='dvcp'
kDVCProNTSCCodecType         ='dvpn'
kDVCProPALCodecType          ='dvpp'
kFireCodecType               ='fire'
kFLCCodecType                ='flic'
k48RGBCodecType              ='b48r'
kGIFCodecType ='gif '
kGraphicsCodecType ='smc '
kH261CodecType               ='h261'
kH263CodecType               ='h263'
kIndeo4CodecType             ='IV41'
kJPEGCodecType               ='jpeg'
kMacPaintCodecType           ='PNTG'
kMicrosoftVideo1CodecType    ='msvc'
kMotionJPEGACodecType        ='mjpa'
kMotionJPEGBCodecType        ='mjpb'
kMpegYUV420CodecType         ='myuv'
kOpenDMLJPEGCodecType        ='dmb1'
kPhotoCDCodecType            ='kpcd'
kPlanarRGBCodecType          ='8BPS'
kPNGCodecType ='png '
kQuickDrawCodecType          ='qdrw'
kQuickDrawGXCodecType        ='qdgx'
kRawCodecType ='raw '
kSGICodecType                ='.SGI'
k16GrayCodecType             ='b16g'
k64ARGBCodecType             ='b64a'
kSorensonCodecType           ='SVQ1'
kSorensonYUV9CodecType       ='syv9'
kTargaCodecType ='tga '
k32AlphaGrayCodecType        ='b32a'
kTIFFCodecType               ='tiff'
kVectorCodecType             ='path'
kVideoCodecType              ='rpza'
kWaterRippleCodecType        ='ripl'
kWindowsRawCodecType         ='WRAW'
kYUV420CodecType ='y420



// --------------------------------------------------------------------------------
static OSErr GetExecutableParentFSSpecFromBundle(FSSpecPtr theFSSpecPtr)
{
	OSErr err = fnfErr;
	CFBundleRef myAppsBundle = CFBundleGetMainBundle();
	//FSCatalogInfo	catInfo;
	FSRef			parentRef;
	FSCatalogInfo	catInfo;
	
	if (myAppsBundle == NULL) return err;
	
	CFURLRef myBundleURL = CFBundleCopyExecutableURL(myAppsBundle);
	
	if (myBundleURL == NULL) return err;


	FSRef myBundleRef;
	Boolean ok = CFURLGetFSRef(myBundleURL, &myBundleRef);
	CFRelease(myBundleURL);
	if (!ok) return err;

	err = FSGetCatalogInfo(&myBundleRef, kFSCatInfoNone, NULL, NULL, theFSSpecPtr, &parentRef);
	if (err)
		return err;
	
	#if 1
	err = FSGetCatalogInfo(&parentRef, kFSCatInfoNone, NULL, NULL, theFSSpecPtr, NULL);
	#endif
	#if 0	
	err = FSGetCatalogInfo(&parentRef, kFSCatInfoNodeID, &catInfo, NULL, theFSSpecPtr, NULL);
	err = FSMakeFSSpec( theFSSpecPtr->vRefNum, catInfo.nodeID, "\pScripts", theFSSpecPtr);
	#endif
	
	return err;
}

//---------------------------------------------------------------------

// !!@ Big issue: what is fundamental file reference type
// FSRef ?? FSSpec ??
// unicode support

#if 0
#define require_noerr(cond,exec)
#define verify_noerr(cond)
#define require(cond,exec)

//---------------------------------------------------------------------
// Gets a file to save from the user. Caller must release the CFURLRef.
//
//static CFURLRef GetSaveFileFromUser(WindowRef window)
static CFURLRef GetSaveFileFromUser(SFReply *theSFReply)
{
	CFURLRef previousFile;
	CFStringRef saveFileName;
	UniChar *chars = NULL;
	CFIndex length;
	NavDialogCreationOptions dialogOptions;
	NavDialogRef dialog;
	NavReplyRecord replyRecord;
	CFURLRef fileAsCFURLRef = NULL;
	FSRef fileAsFSRef;
	FSRef parentDirectory;
	OSStatus status;

	if ( window == NULL ) return NULL;

	// Get the standard set of defaults
	status = NavGetDefaultDialogCreationOptions(&dialogOptions);
	require_noerr( status, CantGetNavOptions );

	// Change a few things (app-wide modal, show the extension)
	dialogOptions.modality = kWindowModalityAppModal;
	dialogOptions.parentWindow = window;
	dialogOptions.optionFlags = kNavDefaultNavDlogOptions | kNavPreserveSaveFileExtension;

	// Set up the default save name
	//previousFile = GetWindowProxyFileCFURL(window);
	//if (previousFile == NULL)
		dialogOptions.saveFileName = CFStringCreateWithCString(NULL, "Untitled.rtf", kCFStringEncodingASCII);
	//else	
	//	dialogOptions.saveFileName = CFURLCopyLastPathComponent(previousFile);

	// Create the dialog
	status = NavCreatePutFileDialog(&dialogOptions, kUnknownType, kUnknownType, NULL, NULL, &dialog);
	require_noerr( status, CantCreateDialog );

	// Show it
	status = NavDialogRun(dialog);
	require_noerr( status, CantRunDialog );
	
	// Get the reply
	status = NavDialogGetReply(dialog, &replyRecord);
	require( ((status == noErr) || (status == userCanceledErr)), CantGetReply );

	// If the user clicked "Cancel", just bail
	if ( status == userCanceledErr ) goto UserCanceled;

	// Get the file's location and name
	status = AEGetNthPtr(&(replyRecord.selection), 1, typeFSRef, NULL, NULL, &parentDirectory, sizeof(FSRef), NULL);
	require_noerr( status, CantExtractFSRef );

	saveFileName = replyRecord.saveFileName;
	length = CFStringGetLength(saveFileName);
	chars = (UniChar *) malloc(length * sizeof(UniChar));
	CFStringGetCharacters(saveFileName, CFRangeMake(0, length), chars);

	// If we are replacing a file, erase the previous one
	if ( replyRecord.replacing ) {
		status = FSMakeFSRefUnicode(&parentDirectory, length, chars, kTextEncodingUnknown, &fileAsFSRef);
		require_noerr( status, CantMakeFSRef );
		status = FSDeleteObject(&fileAsFSRef);
		require_noerr( status, CantDeletePreviousFile );
	}

	// Create the file
	status = FSCreateFileUnicode(&parentDirectory, length, chars, kFSCatInfoNone, NULL, &fileAsFSRef, NULL);
	require_noerr( status, CantCreateSaveFile );

	#if 0
	// Convert the reference to the file to a CFURL
	fileAsCFURLRef = CFURLCreateFromFSRef(NULL, &fileAsFSRef);
	#endif
	
	// Cleanup
CantCreateSaveFile:
CantDeletePreviousFile:
CantMakeFSRef:
	if ( chars != NULL ) free(chars);
CantExtractFSRef:
UserCanceled:
	verify_noerr( NavDisposeReply(&replyRecord) );
CantGetReply:
CantRunDialog:
	NavDialogDispose(dialog);
CantCreateDialog:
	if (previousFile) CFRelease(previousFile);
	CFRelease(dialogOptions.saveFileName);
CantGetNavOptions:
	#if 0
	return fileAsCFURLRef;
	#endif
	
}
#endif
pixelType 16
pixelSize 32

NavGetFile
OSErr NavGetFile (
   AEDesc * defaultLocation,
   NavReplyRecord * reply,
   NavDialogOptions * dialogOptions,
   NavEventUPP eventProc,
   NavPreviewUPP previewProc,
   NavObjectFilterUPP filterProc,
   NavTypeListHandle typeList,
   void * callBackUD
);

NavCreateGetFileDialog
OSStatus NavCreateGetFileDialog (
   const NavDialogCreationOptions * inOptions,
   NavTypeListHandle inTypeList,
   NavEventUPP inEventProc,
   NavPreviewUPP inPreviewProc,
   NavObjectFilterUPP inFilterProc,
   void * inClientData,
   NavDialogRef * outDialog
);

NavPutFile
OSErr NavPutFile (
   AEDesc * defaultLocation,
   NavReplyRecord * reply,
   NavDialogOptions * dialogOptions,
   NavEventUPP eventProc,
   OSType fileType,
   OSType fileCreator,
   void * callBackUD
);

NavCreatePutFileDialog
OSStatus NavCreatePutFileDialog (
   const NavDialogCreationOptions * inOptions,
   OSType inFileType,
   OSType inFileCreator,
   NavEventUPP inEventProc,
   void * inClientData,
   NavDialogRef * outDialog
);

------------------------
    {"diffTolerance",	DS_PROP_diffTolerance,		JSPROP_ENUMERATE|JSPROP_PERMANENT,0,0},
    {"color",			DS_PROP_color,		JSPROP_ENUMERATE|JSPROP_PERMANENT,0,0},

    	case DS_PROP_diffTolerance:
    	{
			jsdouble			num;
			
    		if (doSet)
    		{
	    		if (!JS_ValueToNumber(cx, *vp, &num))
		    		goto exit;
	    		ucontrol->diffTolerance = (int)( num );
    		}
    		else
    		{
    			ok = JS_NewNumberValue(cx, ucontrol->diffTolerance, vp);
    		}
    		break;
    	}
    	case DS_PROP_color:
    	{
    		if (doSet)
    		{
    			DxColor	*newColor;
    			
    			newColor = (DxColor *)ds_GenericGetProp( cx, *vp,
    												kDxProp_value, kDxType_DxColor);
    			ucontrol->color = newColor;
    		}
    		else
    		{
    			// !!@ js color wrapper func needed
    		}
    		break;
    	}

----------------------------

JEditorPane


cd /Users/jht1/Documents/-Work/Dice/Code\ Samples/rhino1_6R2/ 

java -cp build/classes org.mozilla.javascript.tools.debugger.Main  


 java -jar js.jar


ListenToMessage

--------------------------------


StartMovie 
Starts the movie playing from the current movie time.

 StopMovie 
Stops the playback of a movie.

 GoToBeginningOfMovie 
Repositions a movie to play from its start.

 GoToEndOfMovie 
Repositions a movie to play from its end.

void MoviesTask (
   Movie    theMovie,
   long     maxMilliSecToUse );

Boolean IsMovieDone (
   Movie    theMovie );


EnterMovies


	QTUSimpleGetMovie - Get a Movie from a specific file (simpler version)

pascal OSErr QTUSimpleGetMovie(Movie *theMovie)

theMovie				will contain the selected movie when function exits.

DESCRIPTION
	QTUSimpleGetMovie is a simplified version of getting a movie from a file, no need for
	returning refnums, res IDs of keeping track of FSSpecs (compared with QTUGetMovie)
*/

#define	kTypeListCount	1

pascal OSErr QTUSimpleGetMovie(Movie *theMovie)
{
	OSErr 			anErr = noErr;
	short			resFile = 0;
	short			resID = 0;
	Str255			movieName;
	Boolean			wasChanged;
	OSType 			myTypeList[kTypeListCount] = {kQTFileTypeMovie/*, kQTFileTypeQuickTimeImage*/};
	FSSpec			theFSSpec;
    
    anErr = GetOneFileWithPreview (kTypeListCount, (TypeListPtr)&myTypeList, &theFSSpec, NULL);
	if(anErr == noErr)
	{
		anErr = OpenMovieFile(&theFSSpec, &resFile, fsRdPerm); DebugAssert(anErr == noErr);
		if(anErr == noErr)
		{
			anErr = NewMovieFromFile(theMovie, resFile, &resID, movieName, newMovieActive, &wasChanged);
			DebugAssert(anErr == noErr);

			CloseMovieFile(resFile);
		}
	}
	return anErr;
}



	SetMovieGWorld(gMovie, GetWindowPort(gWindow), NULL);





	int						colorCycleNum;
	float					color[3];
	int						color_int[3];
	float					colorCycleDelta[3];
	int						colorCycleCount;
	int						colorCycleIndex;

	
	setupColorCyle()
	{
		color_int = new Color(1,2,3)
		color = new Array();
		colorCycleDelta = new Array();
		colorCycleCount = 30;
		colorCycleIndex = 0;
		
		var i;
		for (i = 0; i < 3; i++)
		{
			colorCycleDelta[i] = 255.0 / colorCycleCount;
			color[i] = 0;
		}
	}

	stepColorCyle()
	{
		var i;
		for (i = 0; i < 3; i++)
		{
			color[i] += colorCycleDelta[i];
		}
		colorCycleIndex++;
		if (colorCycleIndex >= colorCycleCount)
		{
			int		color_target;
			
			for (i = 0; i < 3; i++)
			{
				color_target = Math.random() * 255;
				colorCycleDelta[i] = (color_target - color[i]) / colorCycleCount;
			}
			
			colorCycleIndex = 0;
		}
		color_int.red = color[0];
		color_int.green = color[1];
		color_int.blue = color[2];
	}
	



// Share
    DS_PROP_input,
    DS_PROP_ouptput,


simply verify private has kDxGenericTag
ds_process
 
JS_GetClass(JSObject *obj)

    if (OBJ_GET_CLASS(cx, obj) == clasp)

JS_InitClass
JSClass
?? Mod JS_InitClass to take client info that can be used for class style dispatching

JS_NewArrayObject(JSContext *cx, jsint length, jsval *vector)
JS_IsArrayObject(JSContext *cx, JSObject *obj)
JS_LookupElement(JSContext *cx, JSObject *obj, jsint index, jsval *vp)
JS_GetElement(JSContext *cx, JSObject *obj, jsint index, jsval *vp)
JS_SetElement(JSContext *cx, JSObject *obj, jsint index, jsval *vp)
JS_DeleteElement(JSContext *cx, JSObject *obj, jsint index)

JS_LookupProperty(JSContext *cx, JSObject *obj, const char *name, jsval *vp)
JS_GetProperty(JSContext *cx, JSObject *obj, const char *name, jsval *vp)
JS_SetProperty(JSContext *cx, JSObject *obj, const char *name, jsval *vp)
